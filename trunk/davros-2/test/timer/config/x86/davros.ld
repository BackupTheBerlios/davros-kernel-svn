MEMORY
{
	ram (rwx)		: ORIGIN = 0x00100000, LENGTH = 0x08000000
}

SECTIONS
{
	. = 0x00100000;

	__text_start = .;
	.dv_start			: { *(.dv_start)	}
	.dv_vector			: { *(Vectors)		}
	.text				: { *(.text*)		}
	.rodata				: { *(.rodata*)		}
	__text_end = .;
	__data_start = .;
	.zdata	BLOCK(8)	: { *(.zdata)		}
	.sdata				: { *(.sdata)		}
	.data				: { *(.data)		}
	.edata				: { *(.edata)		}
	__data_end = .;
	__bss_start = .;
	.zbss				: { *(.zbss)		}
	.sbss				: { *(.sbss)		}
	.bss				: { *(.bss)			}
	.eend				: { *(.eend)		}
	__bss_end = .;
	test_heap = .;
	. += 8192;

/* These sections appear to be generated by the compiler.
 * We doesn't use them.
*/
	.stack				: { *(.stack)		}

/* The remainder are DWARF-2 debug sections. They contain
 * ELF relocations and must be located at zero.
*/
	. = 0x0;
	.debug_aranges		: { *(.debug_aranges)	}
	. = 0x0;
	.debug_pubnames		: { *(.debug_pubnames)	}
	. = 0x0;
	.debug_info			: { *(.debug_info)		}
	. = 0x0;
	.debug_abbrev		: { *(.debug_abbrev)	}
	. = 0x0;
	.debug_line			: { *(.debug_line)		}
}
